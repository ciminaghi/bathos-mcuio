## Kconfig
```kconfig
mainmenu "BaThos configuration"

config HAS_MEMORY_MODE
	bool

choice
	prompt "Architecture to build for"

config ARCH_ARM
       bool "ARM architecture"
       help
         This architecture builds BaThos for the ARM architecture

config ARCH_LPC1343
	bool "LPC-1343 -- Cortex-M3"
	select HAS_MEMORY_MODE
	help
	  This architecture builds for LPC1343 and similar processors,
	  by NXP.  This is the original architecture for Thos.
	  Bathos can build both for RAM and FLASH modes.

config ARCH_LPC2104
	bool "LPC2104 -- ARM 7"
	select HAS_MEMORY_MODE
	help
	  This

config ARCH_ATMEGA
	bool "AtMega -- Arduino-like"
	help
	  This

config ARCH_VERSATILE
	bool "VERSATILE -- for Qemu"
	help
	  Build

config ARCH_UNIX
	bool "Unix -- run in a process"
	help
	  Build

endchoice

config ARCH
       string
       default "arm" if ARCH_ARM
       default "lpc1343" if ARCH_LPC1343
       default "lpc2104" if ARCH_LPC2104
       default "atmega" if ARCH_ATMEGA
       default "versatile" if ARCH_VERSATILE
       default "unix" if ARCH_UNIX


config CROSS_COMPILE
       string "Cross compiler prefix"
       default "/opt/arm-2011.03/bin/arm-none-eabi-" if ARCH_ARM
       default "/opt/arm-2011.03/bin/arm-none-eabi-" if ARCH_LPC1343
       default "/opt/arm-2011.03/bin/arm-none-eabi-" if ARCH_LPC2104
       default "/opt/arm-2011.03/bin/arm-none-eabi-" if ARCH_VERSATILE
       default "avr-" if ARCH_ATMEGA
       default ""

choice
	prompt "Memory mode"

config MMODE_RAM
	bool "Build for RAM-based execution" if HAS_MEMORY_MODE
	help
	  Selecting this options, the code will use RAM addresses,
	  and must be programmed to the device with tools/program (prog-ram).
	  At power-off time the program is lost.

config MMODE_FLASH
	bool "Build for flash-based execution" if HAS_MEMORY_MODE
	help
	  Selecting this options, the code will use flash addresses for code,
	  and must be programmed to the device with tools/progrom (prog-rom).
	  Bathos.bin will be persistent in the device.

endchoice

config MEMORY_MODE
       string
       default "-ram" if MMODE_RAM
       default "-flash" if MMODE_FLASH
       default ""

if ARCH_ATMEGA
   source "arch-atmega/Kconfig"
endif

if ARCH_ARM
   source "arch-arm/Kconfig"
endif


   source "tasks/Kconfig"
```

## arch-arm/Kconfig
```kconfig
menu "ARM architecture configuration"

config CPU_CORTEX_M0
       bool

config CPU_CORTEX_M0_PLUS
       bool

config CPU_CORTEX_M3
       bool

config CPU_ARM926EJS
       bool

config HAS_MEMORY_MODE
	bool

config HAS_CORTEXM_SYSTICKTMR
       bool

config CORTEXM_SYSTICKTMR_USE_EXT_CLOCK
       bool

config NR_INTERRUPTS
       int
       default 64 if MACH_VERSATILE
       default 32

config STACK_ADDR
       hex
       default 0x20003000

config VECTABLE_ALIGNMENT
       int
       default 64

config FAMILY_NRF5X
       bool

config FAMILY
       string
       default "nrf5x" if FAMILY_NRF5X

choice
	prompt "SOC to build for"

config MACH_NONE
       bool "NONE"
       select CPU_CORTEX_M0
       help
	 build for no particular machine

config MACH_KL25Z
       bool "Freescale KL25Z"
       select CPU_CORTEX_M0_PLUS
       select HAVE_RELOCATE_INTERRUPT_TABLE
       select HAS_CORTEXM_SYSTICKTMR
       select HAVE_GPIOS
       select HAVE_GPIO_EVENTS
       select FREESCALE_DRIVERS
       select HAVE_UART
       select HAVE_USB_GENERIC_STACK

config MACH_VERSATILE
       bool "ARM Versatile machine (qemu)"
       select CPU_ARM926EJS
       select AMBA_DRIVERS
       select HAVE_UART
       help
         build for qemu versatile machine

config MACH_NRF51822
       bool "Nordic nrf51822"
       select CPU_CORTEX_M0
       select FAMILY_NRF5X
       select NRF5X_DRIVERS
       select HAVE_UART

endchoice

config THOS_QUARTZ
       int "CPU clock frequency"
       default 12000000 if MACH_KL25Z
       default 16000000 if MACH_VERSATILE

config CPU
       string
       default "cortex-m0" if CPU_CORTEX_M0 || CPU_CORTEX_M0_PLUS
       default "cortex-m3" if CPU_CORTEX_M3
       default "arm926ej-s" if CPU_ARM926EJS

config MACH
       default "none" if MACH_NONE
       default "versatile" if MACH_VERSATILE
       default "kl25z" if MACH_KL25Z
       default "nrf51822" if MACH_NRF51822

if MACH_KL25Z
	source arch-arm/mach-kl25z/Kconfig
endif

if MACH_VERSATILE
	source arch-arm/mach-versatile/Kconfig
endif

if FAMILY_NRF5X
	source arch-arm/family-nrf5x/Kconfig
endif

choice
	prompt "Target board for bathos"

config BOARD_NONE
       bool
	prompt "Build for no particular board"

config BOARD_FREEDOG
       bool
       depends on MACH_KL25Z
        prompt "Build for a KL25Z based freedog board"

config BOARD_RB_51822
        bool
	depends on MACH_NRF51822
	 prompt "Builld for a Redbear NRF51822 board"

endchoice

config BOARD
       default "none" if BOARD_NONE
       default "freedog" if BOARD_FREEDOG
       default "rb-nrf51822" if BOARD_RB_51822


config ENDLESS_LOOP_AT_START
       bool
       prompt "Add an endless loop at machine startup"
       default n
       help
        This can be useful in case you want the machine to delay
        boot until a jtag/cmsis-dap emulator has been connected
	Say N if unsure.

endmenu

choice
	prompt "Index of uart console"
	depends on CONSOLE_UART

config	CONSOLE_UART0
	bool "Console on UART0"
	default n

config  CONSOLE_UART1
	bool "Console on UART1"
	default n

config  CONSOLE_UART2
	bool "Console on UART2"
	default n

config  CONSOLE_UART3
	bool "Console on UART3"
	default n

endchoice


config  CONSOLE_DEV_NAME
	string
	default "uart0" if CONSOLE_UART0
	default "uart1" if CONSOLE_UART1
	default "uart2" if CONSOLE_UART2
	default "uart3" if CONSOLE_UART3

choice
	prompt "Index of stdout UART"
	depends on STDOUT_UART

config  STDOUT_UART0
        bool "Stdout to UART0"
	default n

config  STDOUT_UART1
	bool "Stdout to UART1"
	default n

config  STDOUT_UART2
	bool "Stdout to UART2"
	default n

config  STDOUT_UART3
	bool "Stdout to UART3"
	default n

endchoice

config STDOUT
       string
       default CONSOLE if STDOUT_CONSOLE
       default "uart0" if STDOUT_UART0
       default "uart1" if STDOUT_UART1
       default "uart2" if STDOUT_UART2
       default "uart3" if STDOUT_UART3

choice
	prompt "Index of stdin UART"
	depends on STDIN_UART

config  STDIN_UART0
        bool "Stdin from UART0"
	default n

config  STDIN_UART1
	bool "Stdin from UART1"
	default n

config  STDIN_UART2
	bool "Stdin from UART2"
	default n

config  STDIN_UART3
	bool "Stdin from UART3"
	default n

endchoice

config STDIN
       string
       default CONSOLE if STDIN_CONSOLE
       default "uart0" if STDIN_UART0
       default "uart1" if STDIN_UART1
       default "uart2" if STDIN_UART2
       default "uart3" if STDIN_UART3
```

## arch-arm/family-nrf5x/Kconfig
```kconfig
config  HFCLK
	int "nrf5x high frequency clock"
	default 16000000 if MACH_NRF51822

config  LFCLK
	int "nrf5x low frequency clock"
	default 32768 if MACH_NRF51822

choice
       prompt "NRF5X RADIO MODE"
       default NRF5X_RADIO_NONE

config NRF5X_RADIO_MASTER
       bool "Enable nrf5x radio bridge master"
       help
         This adds a radio bridge master driver using the nrf5x low level radio driver

config NRF5X_RADIO_SLAVE
       bool "Enable nrf5x radio bridge slave"
       help
         This adds a radio bridge slave driver using the nrf5x low level

config NRF5X_RADIO_NONE
       bool "No radio bridge driver"
       help
         This disables high level radio drivers

endchoice
```

## arch-arm/family-stm32f4x/Kconfig
```kconfig
config STM32F4X_PLL_M
int
default 4 if BOARD_STAR

config STM32F4X_PLL_N
int
default 180 if BOARD_STAR

config STM32F4X_PLL_P
int
default 8 if BOARD_STAR

config STM32F4X_PLL_Q
int
default 15 if BOARD_STAR

config STM32F4X_PLL_R
int
default 7 if BOARD_STAR

config STM32F4X_APB1_PRESC
int
default 4 if BOARD_STAR

config STM32F4X_APB2_PRESC
int
default 2 if BOARD_STAR

config STM32F4X_AHB_PRESC
int
default 1 if BOARD_STAR
```

## arch-arm/mach-kl25z/Kconfig
```kconfig
choice
	prompt "KL25Z clock configuration"
	default KL25Z_MCG_PEE

config	KL25Z_MCG_FEI
	bool "KL25Z MCG in FLL Engaged Internal mode"
	help
	  External resonator

config  KL25Z_MCG_PEE
	bool "KL25Z MCG in PLL Engaged External mode"
	help
	  External xtal, 8-32MHz

config  KL25Z_MCG_BLPE
	bool "KL25Z MCG in Bypassed Low Power External mode"
	help
	  External oscillator

endchoice


config  KL25Z_RESONATOR_FREQ
	depends on KL25Z_MCG_FEI
	int "KL25Z external resonator frequency"
	default 32768

config  KL25Z_XTAL_FREQ
       	int "KL25Z external crystal frequency"
	depends on KL25Z_MCG_PEE
	default 8000000 if BOARD_FREEDOG

config  KL25Z_OSC_FREQ
	int "KL25Z external oscillator frequency"
	depends on KL25Z_MCG_BLPE
	default 8000000

config  KL25Z_BUS_FREQ
       	int "KL25 bus frequency"
	default 24000000

choice
	prompt "Index of uart console"
	depends on CONSOLE_UART

config	CONSOLE_UART0
	bool "Console on KL25Z UART0"
	default n

config  CONSOLE_UART1
	bool "Console on KL25Z UART1"
	default n

config  CONSOLE_UART2
	bool "Console on KL25Z UART2"
	default n

endchoice

config  CONSOLE_DEV_NAME
	string
	default "uart0" if CONSOLE_UART0
	default "uart1" if CONSOLE_UART1
	default "uart2" if CONSOLE_UART2

choice
	prompt "Index of stdout UART"
	depends on STDOUT_UART

config  STDOUT_UART0
        bool "Stdout to KL25Z UART0"
	default n

config  STDOUT_UART1
	bool "Stdout to KL25Z UART1"
	default n

config  STDOUT_UART2
	bool "Stdout to KL25Z UART2"
	default n

endchoice

config STDOUT
       string
       default CONSOLE if STDOUT_CONSOLE
       default "uart0" if STDOUT_UART0
       default "uart1" if STDOUT_UART1
       default "uart2" if STDOUT_UART2
       default "usb-serial-0" if STDOUT_USB_UART

choice
	prompt "Index of stdin UART"
	depends on STDIN_UART

config  STDIN_UART0
        bool "Stdin from KL25Z UART0"
	default n

config  STDIN_UART1
	bool "Stdin from KL25Z UART1"
	default n

config  STDIN_UART2
	bool "Stdin from KL25Z UART2"
	default n

endchoice

config STDIN
       string
       default CONSOLE if STDIN_CONSOLE
       default "uart0" if STDIN_UART0
       default "uart1" if STDIN_UART1
       default "uart2" if STDIN_UART2
       default "usb-serial-0" if STDIN_USB_UART
```

## arch-arm/mach-nrf51822/Kconfig
```kconfig
config  HFCLK
	int "nrf5x high frequency clock"
	default 16000000 if MACH_NRF51822

config  LFCLK
	int "nrf5x low frequency clock"
	default 32768 if MACH_NRF51822
```

## arch-atmega/Kconfig
```kconfig
config HAVE_USB
       bool

choice
	prompt "Target machine for bathos"
	default MACH_ATMEGA32U4

config MACH_ATMEGA8
       prompt "Build for an ATMEGA8"
       bool
       help
         Build for an atmega8 MPU

config MACH_ATMEGA32U4
       prompt "Build for and ATMEGA 32U4"
       bool
       select HAVE_USB
       help
         Build for an atmega 32U4 MPU

endchoice

if MACH_ATMEGA32U4

choice
	prompt "Target board for bathos"

config BOARD_ARDUINOYUN
	prompt "Build for Arduino Yun"
	bool

config BOARD_LININOONE
	prompt "Build for Linino One"
	bool

endchoice

endif

config MACH
       string
       default "atmega8" if MACH_ATMEGA8
       default "atmega32u4" if MACH_ATMEGA32U4

config ATMEGA_USB_UART
       bool "Atmega Usb-uart driver"
       select HAVE_USB_UART
       depends on HAVE_USB
       help
         Add an UART over USB driver for the atmega

config ATMEGA_UART
       bool "Atmega UART driver"
       select HAVE_UART
       help
         Add an UART driver for the atmega

config ATMEGA_SPI
       bool "Atmega SPI driver"
       select HAVE_SPI
       help
         Add a SPI driver for the atmega

choice
	prompt "Bathos console"

config CONSOLE_DEBUG_BITBANG
       bool "Console on debug bitbang"
       depends on DEBUG_BITBANG
       help
         This option selects the debug bitbang console as the console device.
	 This console only works as an output.
	 See Documentation/atmega for more details.

config CONSOLE_UART
       bool "Console on UART"
       help
         This option selects a console on the chip's UART device

config CONSOLE_USB_UART
       bool "Console on usb (ACM device)"
       depends on USB_UART
       help
	 This option selects a console via USB

config CONSOLE_NULL
       bool "Null console"
       help
	 Select this when you don't want any console

endchoice

config CONSOLE
       string
       default "avr-uart" if CONSOLE_UART
       default "usb-uart" if CONSOLE_USB_UART

config EARLY_CONSOLE
       bool "Setup an early console"
       depends on !CONSOLE_USB_UART

choice
	prompt "Bathos stdin"

config STDIN_CONSOLE
       bool "Stdin from console"
       help
         Take standard input from selected console

config STDIN_UART
       bool "Stdin from UART"
       depends on UART
       help
	 Get standard input from uart

config STDIN_USB_UART
       bool "Stdin from USB-UART"
       depends on USB_UART
       help
         Get standard input from usb-uart device
endchoice

config STDIN
       string
       default CONSOLE if STDIN_CONSOLE
       default "avr-uart" if STDIN_UART
       default "usb-uart" if STDIN_USB_UART

choice
	prompt "Bathos stdout"

config STDOUT_CONSOLE
       bool "Stdout to console"
       help
         Send stdandard output to selected console

config STDOUT_UART
       bool "Stdout to UART"	
       depends on UART
       help
         Send standard output from uart

config STDOUT_USB_UART
       bool "Stdout to USB-UART"
       depends on USB_UART
       help
         Send standard output to usb-uart device
endchoice

config STDOUT
       string
       default CONSOLE if STDOUT_CONSOLE
       default "avr-uart" if STDOUT_UART
       default "usb-uart" if STDOUT_USB_UART

config COPY_STDOUT_TO_CONSOLE
       bool "Copy stdout to console"
       depends on !STDOUT_CONSOLE
       help
         Copy standard output to console

config SMALLSIZE
	bool "Shrink and optimize for size"
	help
	  Remove verbose or useless code, to minimize size in flash"

config ADD_EXTERNAL_BOOTLOADER
       bool "Add external bootloader"
       help
         Add pre-compiled bootloader (hex format) to final image

config EXTERNAL_BOOTLOADER_PATH
       string "External bootloader path"
       depends on ADD_EXTERNAL_BOOTLOADER
       default "Caterina-Yun.hex" if BOARD_ARDUINOYUN
       default "Caterina-LininoOne.hex" if BOARD_LININOONE
       help
         Path of hex file containing external bootloader (placed in top 4k of
	 ATMEGA flash).

config RUN_BOOTLOADER_ON_1200_BPS
       bool "Run bootloader when 1200 bps is set"
       depends on USB_UART
	help
	  Die and run bootloader when a 1200 baud setting is detected
	  on the usb-uart port. This is required for compatibility with
	  Arduino fw updater.
```

## drivers/Kconfig
```kconfig
config DEBUG_BITBANG
       bool "Debug bitbang driver"
       default n
       help
         Add a debug bitbang driver

if DEBUG_BITBANG

config BB_CLOCK_GPIO
       int "Bitbang driver clock gpio number"
       help
	 Guess what

config BB_DATA_GPIO
       int "Bitbang driver data gpio number"
       help
         Guess what

config CONSOLE
       string
       default "debug-bitbang" if CONSOLE_DEBUG_BITBANG

endif

config FREESCALE_DRIVERS
       bool

config AMBA_DRIVERS
       bool

config USB_CONFIG_FILE
       string "Usb configuration file"
       default "configs/freedog_usb_config" if KL25Z_BOARD_FREEDOG
```

## tasks/Kconfig
```kconfig
config TASK_LOOPBACK_PIPE
       prompt "Loopback test for configurable pipe"
       bool
       help
         This enables a loopback for a pipe selected via
	 CONFIG_LOOPBACK_PIPE_NAME

config LOOPBACK_PIPE_NAME
       prompt "Pipe name for loopback test"
       depends on TASK_LOOPBACK_PIPE
       string
       help
         This defines a pipe's path for the loopback test.
	 The pipe is opened rw, and whatever is read from
	 it is immediately written back.
```
